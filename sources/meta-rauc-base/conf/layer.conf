## sources/meta-rauc-base/conf/layer.conf
```bitbake
# We have a conf and classes directory, add to BBPATH
BBPATH .= ":${LAYERDIR}"

# We have recipes-* directories, add to BBFILES
BBFILES += "${LAYERDIR}/recipes-*/*/*.bb \
            ${LAYERDIR}/recipes-*/*/*.bbappend"

BBFILE_COLLECTIONS += "meta-rauc-base"
BBFILE_PATTERN_meta-rauc-base = "^${LAYERDIR}/"
BBFILE_PRIORITY_meta-rauc-base = "6"

LAYERDEPENDS_meta-rauc-base = "core"
LAYERSERIES_COMPAT_meta-rauc-base = "kirkstone"
```

## x86-64-build/conf/bblayers.conf
```bitbake
# POKY_BBLAYERS_CONF_VERSION is increased each time build/conf/bblayers.conf
# changes incompatibly
POKY_BBLAYERS_CONF_VERSION = "2"

BBPATH = "${TOPDIR}"
YOCTOROOT = "${@os.path.abspath(os.path.join("${TOPDIR}", os.pardir))}"
BBFILES ?= ""

BBLAYERS ?= " \
  ${YOCTOROOT}/sources/poky/meta \
  ${YOCTOROOT}/sources/poky/meta-poky \
  ${YOCTOROOT}/sources/poky/meta-yocto-bsp \
  ${YOCTOROOT}/sources/meta-rauc \
  ${YOCTOROOT}/sources/meta-rauc-base \
  "
```
